## CMakeLists.txt
```
cmake_minimum_required(VERSION 3.20.0)
find_package(Zephyr REQUIRED HINTS $ENV{ZEPHYR_BASE})
project(peripheral_nus)

target_sources(app PRIVATE
        src/main.c
        src/cmd_parser.c
)
```

## prj.conf
```kconfig
CONFIG_BT=y
CONFIG_BT_PERIPHERAL=y
CONFIG_BT_ZEPHYR_NUS=y

CONFIG_USE_SEGGER_RTT=y
CONFIG_RTT_CONSOLE=y
CONFIG_UART_CONSOLE=n
CONFIG_PRINTK=y
CONFIG_CONSOLE=y
```

## src/main.c
```c
/*
 * Copyright (c) 2024 Croxel, Inc.
 *
 * SPDX-License-Identifier: Apache-2.0
 */

#include <zephyr/kernel.h>
#include <zephyr/bluetooth/bluetooth.h>
#include <zephyr/bluetooth/conn.h>
#include <zephyr/bluetooth/hci.h>
#include <zephyr/bluetooth/services/nus.h>

#include <string.h>
#include <stdbool.h>
#include <stdint.h>
#include <errno.h>

#include "cmd_parser.h"

#define DEVICE_NAME     CONFIG_BT_DEVICE_NAME
#define DEVICE_NAME_LEN (sizeof(DEVICE_NAME) - 1)

#define RX_BUF_SIZE             512     /* fits a 6-slot multi request (~340 bytes) */
#define CMD_TERMINATOR          '#'
#define TRACE_SEND_DELAY_MS     60
#define TRACE_SEND_RETRIES      3
#define TRACE_X_SCALE           1000
#define TRACE_Y_SCALE           1000000

/* Simulated per-slot acquisition time of a multi-channel request. */
#define ACQ_SIM_MS              2000
/* Added to the computed procedure bound t sent in the R frame. */
#define PROC_T_SLACK_S          5

/*
 * Failure injection for testing X<slot>,ACQ_FAIL handling: the simulated
 * acquisition of any slot on this channel fails. -1 disables it. Override
 * at build time, e.g. west build ... -- -DEXTRA_CFLAGS=-DSIM_FAIL_CHANNEL=4
 */
#ifndef SIM_FAIL_CHANNEL
#define SIM_FAIL_CHANNEL        (-1)
#endif

static char rx_buf[RX_BUF_SIZE];
static size_t rx_len = 0;

struct trace_point {
	int32_t voltage_mv_scaled;   /* int32_t: values reach ±340040, overflows int16_t */
	int32_t current_na_scaled;   /* int32_t: values reach 830894, overflows int16_t */
};

/*
 * Real IV-curve measurement data (result_001_scaled.json).
 *
 * Values are scaled integers. To recover physical units:
 *   real_voltage_mV = voltage_mv_scaled / TRACE_X_SCALE
 *   real_current_nA = current_na_scaled / TRACE_Y_SCALE
 *
 * Each point will be sent as one notification:
 *
 *   <index>,<voltage_mv_scaled>,<current_na_scaled>
 */
static const struct trace_point trace_data[] = {
	{ -340040, 406027 }, { -330040, 385046 }, { -320041, 374079 },
	{ -310040, 387907 }, { -300040, 367403 }, { -290040, 371695 },
	{ -280040, 387430 }, { -270041, 413179 }, { -260040, 455618 },
	{ -250040, 509024 }, { -240040, 583887 }, { -230040, 652080 },
	{ -220040, 734572 }, { -210040, 804191 }, { -200118, 817542 },
	{ -190118, 830894 }, { -180118, 796561 }, { -170117, 740294 },
	{ -160118, 673537 }, { -150118, 592470 }, { -140118, 535727 },
	{ -130117, 481367 }, { -120117, 446558 }, { -110118, 417948 },
	{ -100118, 395060 }, { -90117,  385046 }, { -80117,  382185 },
	{ -70117,  378370 }, { -60196,  382185 }, { -50196,  377417 },
	{ -40195,  378370 }, { -30195,  379801 }, { -20195,  393152 },
	{ -10196,  395536 }, { -196,    403643 },
};

static size_t trace_index = 0;
static struct bt_conn *trace_conn;
static bool trace_tx_busy = false;

struct measurement_channel {
	bool present;
	uint8_t value;
};

static struct measurement_channel current_channel;

/*
 * Multi-channel procedure state. Unused (multi == false) for legacy
 * single-channel commands.
 */
struct procedure {
	bool multi;
	struct multi_request req;
	uint8_t slot;
	uint8_t ok;
	uint8_t failed;
};

static struct procedure proc;

/* Parsed in the NUS RX callback; copied into proc only when a transfer starts. */
static struct multi_request pending_req;

enum trace_tx_phase {
	TRACE_TX_IDLE,
	TRACE_TX_ACCEPT,     /* multi: R<id>,<n>,<t> */
	TRACE_TX_ACQUIRE,    /* multi: simulated acquisition of proc.slot finished */
	TRACE_TX_CHAN_HDR,   /* multi: C<slot>,<channel> */
	TRACE_TX_BEGIN,
	TRACE_TX_SCALE,
	TRACE_TX_DATA,
	TRACE_TX_END,
	TRACE_TX_SLOT_FAIL,  /* multi: X<slot>,ACQ_FAIL */
	TRACE_TX_DONE,       /* multi: D<id>,<ok>,<failed> */
};

static enum trace_tx_phase trace_phase = TRACE_TX_IDLE;
static struct k_work_delayable trace_work;
static uint8_t tx_retries;

/*
 * Signalled from on_disconnected() to wake the main loop for advertising restart.
 * Avoids calling bt_le_adv_start() from a BT callback or a work handler,
 * both of which previously caused MPU faults on this target.
 */
K_SEM_DEFINE(adv_restart_sem, 0, 1);

static const struct bt_data ad[] = {
	BT_DATA_BYTES(BT_DATA_FLAGS, (BT_LE_AD_GENERAL | BT_LE_AD_NO_BREDR)),
	BT_DATA(BT_DATA_NAME_COMPLETE, DEVICE_NAME, DEVICE_NAME_LEN),
};

static const struct bt_data sd[] = {
	BT_DATA_BYTES(BT_DATA_UUID128_ALL, BT_UUID_NUS_SRV_VAL),
};

static void finish_trace_transfer(void);

static void on_connected(struct bt_conn *conn, uint8_t err)
{
	if (err) {
		printk("Connection failed: %u\n", err);
		return;
	}
	printk("Connected\n");
}

static void on_disconnected(struct bt_conn *conn, uint8_t reason)
{
	printk("Disconnected (reason %u)\n", reason);

	finish_trace_transfer();

	k_sem_give(&adv_restart_sem);
}

BT_CONN_CB_DEFINE(conn_callbacks) = {
	.connected    = on_connected,
	.disconnected = on_disconnected,
};

static int send_text_notification(struct bt_conn *conn, const char *text)
{
	int err = bt_nus_send(conn, text, strlen(text));

	printk("Notify send: \"%s\" result: %d\n", text, err);

	return err;
}

static void finish_trace_transfer(void)
{
	if (trace_conn != NULL) {
		bt_conn_unref(trace_conn);
		trace_conn = NULL;
	}

	trace_index = 0;
	trace_phase = TRACE_TX_IDLE;
	trace_tx_busy = false;
	tx_retries = 0;
	current_channel = (struct measurement_channel){0};
	proc = (struct procedure){0};

	printk("Trace transfer finished\n");
}

static void schedule_phase(enum trace_tx_phase phase, k_timeout_t delay)
{
	trace_phase = phase;
	k_work_schedule(&trace_work, delay);
}

/**
 * @brief Send one frame of the current phase, retrying on failure.
 *
 * On failure (typically -ENOMEM when the BLE TX buffer pool is exhausted),
 * the same phase is rescheduled with a growing back-off and the frame is
 * rebuilt and resent. After TRACE_SEND_RETRIES failures the link is dropped,
 * so the client observes a disconnect instead of silence.
 *
 * @return true if the frame was sent and the caller may advance the phase;
 *         false if the caller must return without changing any state.
 */
static bool send_frame(const char *line)
{
	int err = send_text_notification(trace_conn, line);

	if (err == 0) {
		tx_retries = 0;
		return true;
	}

	if (tx_retries < TRACE_SEND_RETRIES) {
		tx_retries++;
		printk("Send failed (%d), retry %u/%u\n", err, tx_retries, TRACE_SEND_RETRIES);
		k_work_schedule(&trace_work, K_MSEC(TRACE_SEND_DELAY_MS * (tx_retries + 1)));
		return false;
	}

	printk("Send failed (%d), giving up and disconnecting\n", err);
	bt_conn_disconnect(trace_conn, BT_HCI_ERR_REMOTE_USER_TERM_CONN);
	finish_trace_transfer();
	return false;
}

/*
 * Upper bound in seconds on the time from R to D, sent as t in the R frame.
 * Per slot: simulated acquisition plus C, B, S, E and the data frames.
 */
static unsigned int procedure_bound_s(uint8_t n)
{
	uint32_t per_slot_ms = ACQ_SIM_MS +
			       (ARRAY_SIZE(trace_data) + 4) * TRACE_SEND_DELAY_MS;
	uint32_t total_ms = n * per_slot_ms + 2 * TRACE_SEND_DELAY_MS;

	return DIV_ROUND_UP(total_ms, 1000) + PROC_T_SLACK_S;
}

static bool slot_acquisition_fails(const struct slot_cfg *slot)
{
	return (int)slot->channel == SIM_FAIL_CHANNEL;
}

/* Move to the next slot's acquisition, or to D after the last slot. */
static void advance_slot(void)
{
	proc.slot++;
	trace_index = 0;

	if (proc.slot < proc.req.n) {
		printk("Acquiring slot %u (channel %u)\n",
		       proc.slot, proc.req.slots[proc.slot].channel);
		schedule_phase(TRACE_TX_ACQUIRE, K_MSEC(ACQ_SIM_MS));
	} else {
		schedule_phase(TRACE_TX_DONE, K_MSEC(TRACE_SEND_DELAY_MS));
	}
}

/**
 * @brief Send the trace response as several NUS notifications.
 *
 * Compact protocol (all frames ≤ 18 bytes, fits default BLE payload):
 *
 *   B<count>
 *   S<x_scale>,<y_scale>
 *   <index>,<voltage_mv_scaled>,<current_na_scaled>
 *   ...
 *   E<count>
 *
 * The S frame carries the scale factors needed to reconstruct physical units:
 *   real_voltage_mV = voltage_mv_scaled / x_scale
 *   real_current_nA = current_na_scaled / y_scale
 *
 * For a multi-channel request the same block is sent once per slot, preceded
 * by C<slot>,<channel>, and the whole procedure is wrapped in R ... D:
 *
 *   R<id>,<n>,<t>
 *   C<slot>,<channel>  B..E       (or X<slot>,ACQ_FAIL)   -- per slot
 *   D<id>,<ok>,<failed>
 *
 * The dummy firmware "acquires" a slot by waiting ACQ_SIM_MS and streams its
 * block right after, so it buffers at most one dataset. The contract also
 * allows deferring blocks; see docs/ble/BLE_CHUNKED_TRACE_PROTOCOL.md.
 *
 * This work handler runs outside the NUS RX callback. That keeps command
 * reception and longer trace transmission structurally separated.
 */
static void trace_work_handler(struct k_work *work)
{
	ARG_UNUSED(work);

	char line[48];

	if (trace_conn == NULL) {
		finish_trace_transfer();
		return;
	}

	switch (trace_phase) {
	case TRACE_TX_ACCEPT:
		snprintk(line, sizeof(line), "R%u,%u,%u\n",
			 proc.req.id, proc.req.n, procedure_bound_s(proc.req.n));
		if (!send_frame(line)) {
			return;
		}

		printk("Acquiring slot 0 (channel %u)\n", proc.req.slots[0].channel);
		schedule_phase(TRACE_TX_ACQUIRE, K_MSEC(ACQ_SIM_MS));
		break;

	case TRACE_TX_ACQUIRE:
		if (slot_acquisition_fails(&proc.req.slots[proc.slot])) {
			schedule_phase(TRACE_TX_SLOT_FAIL, K_NO_WAIT);
		} else {
			schedule_phase(TRACE_TX_CHAN_HDR, K_NO_WAIT);
		}
		break;

	case TRACE_TX_CHAN_HDR:
		snprintk(line, sizeof(line), "C%u,%u\n",
			 proc.slot, proc.req.slots[proc.slot].channel);
		if (!send_frame(line)) {
			return;
		}

		schedule_phase(TRACE_TX_BEGIN, K_MSEC(TRACE_SEND_DELAY_MS));
		break;

	case TRACE_TX_BEGIN:
		if (proc.multi) {
			printk("Starting trace for slot %u\n", proc.slot);
		} else if (current_channel.present) {
			printk("Starting trace on channel %u\n", current_channel.value);
		} else {
			printk("Starting trace (no channel specified)\n");
		}

		snprintk(line, sizeof(line), "B%u\n",
			 (unsigned int)ARRAY_SIZE(trace_data));
		if (!send_frame(line)) {
			return;
		}

		schedule_phase(TRACE_TX_SCALE, K_MSEC(TRACE_SEND_DELAY_MS));
		break;

	case TRACE_TX_SCALE:
		snprintk(line, sizeof(line), "S%d,%d\n",
			 TRACE_X_SCALE,
			 TRACE_Y_SCALE);
		if (!send_frame(line)) {
			return;
		}

		schedule_phase(TRACE_TX_DATA, K_MSEC(TRACE_SEND_DELAY_MS));
		break;

	case TRACE_TX_DATA:
		if (trace_index < ARRAY_SIZE(trace_data)) {
			const struct trace_point *point = &trace_data[trace_index];

			snprintk(line, sizeof(line),
				 "%u,%d,%d\n",
				 (unsigned int)trace_index,
				 point->voltage_mv_scaled,
				 point->current_na_scaled);
			if (!send_frame(line)) {
				return;
			}

			trace_index++;
			k_work_schedule(&trace_work, K_MSEC(TRACE_SEND_DELAY_MS));
		} else {
			schedule_phase(TRACE_TX_END, K_NO_WAIT);
		}
		break;

	case TRACE_TX_END:
		snprintk(line, sizeof(line), "E%u\n",
			 (unsigned int)ARRAY_SIZE(trace_data));
		if (!send_frame(line)) {
			return;
		}

		if (!proc.multi) {
			finish_trace_transfer();
			break;
		}

		proc.ok++;
		advance_slot();
		break;

	case TRACE_TX_SLOT_FAIL:
		snprintk(line, sizeof(line), "X%u,ACQ_FAIL\n", proc.slot);
		if (!send_frame(line)) {
			return;
		}

		proc.failed++;
		advance_slot();
		break;

	case TRACE_TX_DONE:
		snprintk(line, sizeof(line), "D%u,%u,%u\n",
			 proc.req.id, proc.ok, proc.failed);
		if (!send_frame(line)) {
			return;
		}

		finish_trace_transfer();
		break;

	case TRACE_TX_IDLE:
	default:
		finish_trace_transfer();
		break;
	}
}

/**
 * @brief Start sending a multi-notification trace response.
 *
 * Only one trace transfer is allowed at a time in this MVP.
 * If another complete command arrives while a trace is still being sent,
 * firmware responds with ERR=BUSY.
 */
static void start_trace_transfer(struct bt_conn *conn)
{
	if (trace_tx_busy) {
		send_text_notification(conn, "ERR=BUSY\n");
		return;
	}

	trace_conn = bt_conn_ref(conn);
	trace_index = 0;
	trace_tx_busy = true;

	printk("Starting trace transfer\n");

	schedule_phase(TRACE_TX_BEGIN, K_NO_WAIT);
}

/*
 * Level-3 (hardware capability) validation hook, run on every slot before
 * the request is accepted. Returns the name of the first field the hardware
 * cannot honour, or NULL. The dummy firmware has no hardware limits yet.
 */
static const char *hw_check_slot(const struct slot_cfg *slot)
{
	ARG_UNUSED(slot);

	return NULL;
}

/**
 * @brief Validate a multi-channel request and start its procedure.
 *
 * Everything is validated before R is sent, so a rejected request never
 * acquires anything. Rejections are a single terminal frame:
 *
 *   ERR=<code>               request-level (BUSY, SYNTAX, SLOT_COUNT)
 *   V<slot>,<key>,<code>     slot-level (SYNTAX, MISSING, DUP, UNKNOWN, RANGE, HW)
 */
static void handle_multi_request(struct bt_conn *conn, const char *cmd)
{
	struct request_error_info err;
	char line[32];

	if (trace_tx_busy) {
		send_text_notification(conn, "ERR=BUSY\n");
		return;
	}

	enum request_error result = parse_multi_request(cmd, &pending_req, &err);

	for (uint8_t i = 0; result == REQUEST_OK && i < pending_req.n; i++) {
		const char *key = hw_check_slot(&pending_req.slots[i]);

		if (key != NULL) {
			result = REQUEST_ERR_HW;
			err = (struct request_error_info){
				.code = REQUEST_ERR_HW, .slot = i, .key = key,
			};
		}
	}

	if (result == REQUEST_OK) {
		trace_conn = bt_conn_ref(conn);
		trace_index = 0;
		trace_tx_busy = true;
		proc = (struct procedure){ .multi = true, .req = pending_req };

		printk("Starting multi procedure REQ=%u N=%u\n",
		       pending_req.id, pending_req.n);

		schedule_phase(TRACE_TX_ACCEPT, K_NO_WAIT);
		return;
	}

	if (err.slot < 0) {
		snprintk(line, sizeof(line), "ERR=%s\n", request_error_str(err.code));
	} else {
		snprintk(line, sizeof(line), "V%d,%s,%s\n",
			 err.slot, err.key, request_error_str(err.code));
	}

	printk("Rejected multi request\n");
	send_text_notification(conn, line);
}

static void notif_enabled(bool enabled, void *ctx)
{
	ARG_UNUSED(ctx);

	printk("%s() - %s\n", __func__, enabled ? "Enabled" : "Disabled");
}

/**
 * @brief Handle incoming NUS RX writes and reconstruct terminated commands.
 *
 * One BLE write is treated as one fragment, not necessarily as one complete
 * command. Fragments are appended to rx_buf until CMD_TERMINATOR is received.
 *
 * Current manual-test terminator:
 *
 *   '#'
 *
 * Example app writes:
 *
 *   START=-800;
 *   END=0;
 *   FREQ=100;
 *   RANGE=10;
 *   CHANNEL=7#
 *
 * Reconstructed command:
 *
 *   START=-800;END=0;FREQ=100;RANGE=10;CHANNEL=7
 *
 * START, END, FREQ, and RANGE are reconstructed but not yet parsed or
 * validated. Field units (for when parsing is implemented): START/END in
 * mV, FREQ in Hz, RANGE in µA (changed from nA — do not confuse with the
 * unrelated nA unit used for measured trace-output current, see
 * trace_point below). CHANNEL is parsed and validated: it must be an integer in
 * 0..255, and it is optional (its absence is not an error and is not
 * treated as channel 0). See cmd_parser.h.
 *
 * Notification behavior:
 *
 * - Non-final fragment:
 *     FRAG_OK
 *
 * - Final fragment containing '#', with a valid or absent CHANNEL:
 *     starts multi-notification trace response
 *
 * - Final fragment containing '#', with an invalid CHANNEL value:
 *     ERR=CHANNEL_INVALID
 *
 * - Buffer overflow:
 *     ERR=RX_OVERFLOW
 *
 * A command containing a REQ= field is a multi-channel request instead
 * (REQ=<id>;N=<n>;SLOT=0;CHANNEL=..;START=..;END=..;FREQ=..;RANGE=..;SLOT=1;...),
 * handled by handle_multi_request(). The fragment/FRAG_OK/'#' handling is
 * the same for both; fragment boundaries are arbitrary.
 */
static void received(struct bt_conn *conn, const void *data, uint16_t len, void *ctx)
{
	const char *bytes = data;
	bool command_completed = false;

	ARG_UNUSED(ctx);

	printk("%s() - Len: %u, Fragment: %.*s\n",
	       __func__, (unsigned int)len, (int)len, bytes);

	for (uint16_t i = 0; i < len; i++) {
		char c = bytes[i];

		if (c == CMD_TERMINATOR) {
			uint8_t channel = 0;
			enum channel_parse_result channel_result;

			rx_buf[rx_len] = '\0';

			printk("Full command: %s\n", rx_buf);

			if (is_multi_request(rx_buf)) {
				handle_multi_request(conn, rx_buf);
				rx_len = 0;
				command_completed = true;
				continue;
			}

			channel_result = parse_channel_field(rx_buf, &channel);

			if (channel_result == CHANNEL_FIELD_INVALID) {
				printk("Rejected command: invalid CHANNEL\n");
				send_text_notification(conn, "ERR=CHANNEL_INVALID\n");
			} else {
				current_channel.present = (channel_result == CHANNEL_FIELD_VALID);
				current_channel.value = channel;

				start_trace_transfer(conn);
			}

			rx_len = 0;
			command_completed = true;
		} else {
			if (rx_len < sizeof(rx_buf) - 1) {
				rx_buf[rx_len++] = c;
			} else {
				printk("RX buffer overflow, clearing\n");

				rx_len = 0;
				command_completed = true;

				send_text_notification(conn, "ERR=RX_OVERFLOW\n");
			}
		}
	}

	if (!command_completed) {
		send_text_notification(conn, "FRAG_OK\n");
	}
}

static struct bt_nus_cb nus_listener = {
	.notif_enabled = notif_enabled,
	.received = received,
};

int main(void)
{
	int err;

	printk("Sample - Bluetooth Peripheral NUS Value-Pair Trace Protocol\n");

	k_work_init_delayable(&trace_work, trace_work_handler);

	/* Register NUS callbacks before bt_enable — safe because bt_nus_cb_register
	 * only appends to a statically-initialized slist and has no BT stack dependency.
	 * This matches the official Zephyr peripheral_nus sample pattern. */
	err = bt_nus_cb_register(&nus_listener, NULL);
	if (err) {
		printk("Failed to register NUS callback: %d\n", err);
		return err;
	}

	err = bt_enable(NULL);
	if (err) {
		printk("Failed to enable Bluetooth: %d\n", err);
		return err;
	}

	err = bt_le_adv_start(BT_LE_ADV_CONN_FAST_1,
			      ad, ARRAY_SIZE(ad),
			      sd, ARRAY_SIZE(sd));
	if (err) {
		printk("Failed to start advertising: %d\n", err);
		return err;
	}

	printk("Initialization complete\n");

	while (true) {
		k_sem_take(&adv_restart_sem, K_FOREVER);

		k_sleep(K_MSEC(200));

		err = bt_le_adv_start(BT_LE_ADV_CONN_FAST_1,
				      ad, ARRAY_SIZE(ad),
				      sd, ARRAY_SIZE(sd));
		if (err == -EALREADY) {
			printk("Advertising already active\n");
		} else if (err) {
			printk("Failed to restart advertising: %d\n", err);
		} else {
			printk("Advertising restarted\n");
		}
	}

	return 0;
}
```

## src/cmd_parser.c
```c
/*
 * Copyright (c) 2024 Croxel, Inc.
 *
 * SPDX-License-Identifier: Apache-2.0
 */

#include "cmd_parser.h"

#include <stdbool.h>
#include <stddef.h>
#include <string.h>

#define CHANNEL_KEY     "CHANNEL="
#define CHANNEL_KEY_LEN (sizeof(CHANNEL_KEY) - 1)
#define CHANNEL_MIN     0
#define CHANNEL_MAX     255
#define REQ_ID_MIN      1
#define REQ_ID_MAX      65535

/*
 * Strict base-10 parse of [value, value_end): optional leading '-', digits
 * only, no partial/trailing garbage, result must fit in int32_t.
 * Returns 0 and writes *out on success, -1 otherwise.
 */
static int parse_int32_strict(const char *value, const char *value_end, int32_t *out)
{
	if (value == value_end) {
		return -1;
	}

	const char *p = value;
	bool negative = false;

	if (*p == '-') {
		negative = true;
		p++;
	}

	if (p == value_end) {
		return -1;
	}

	int64_t result = 0;

	for (; p < value_end; p++) {
		if (*p < '0' || *p > '9') {
			return -1;
		}

		result = result * 10 + (*p - '0');

		/* Bail out as soon as the magnitude can no longer fit, which
		 * also avoids int64_t overflow on long digit strings.
		 */
		if (result > (int64_t)INT32_MAX + 1) {
			return -1;
		}
	}

	if (negative) {
		result = -result;
	}

	if (result < INT32_MIN || result > INT32_MAX) {
		return -1;
	}

	*out = (int32_t)result;
	return 0;
}

static int parse_channel_value(const char *value, const char *value_end, uint8_t *out_channel)
{
	int32_t result;

	if (parse_int32_strict(value, value_end, &result) != 0 ||
	    result < CHANNEL_MIN || result > CHANNEL_MAX) {
		return -1;
	}

	*out_channel = (uint8_t)result;
	return 0;
}

enum channel_parse_result parse_channel_field(const char *cmd, uint8_t *out_channel)
{
	const char *seg_start = cmd;

	while (*seg_start != '\0') {
		const char *seg_end = strchr(seg_start, ';');

		if (seg_end == NULL) {
			seg_end = seg_start + strlen(seg_start);
		}

		size_t seg_len = (size_t)(seg_end - seg_start);

		if (seg_len >= CHANNEL_KEY_LEN &&
		    strncmp(seg_start, CHANNEL_KEY, CHANNEL_KEY_LEN) == 0) {
			const char *value = seg_start + CHANNEL_KEY_LEN;

			if (parse_channel_value(value, seg_end, out_channel) == 0) {
				return CHANNEL_FIELD_VALID;
			}

			return CHANNEL_FIELD_INVALID;
		}

		if (*seg_end == '\0') {
			break;
		}

		seg_start = seg_end + 1;
	}

	return CHANNEL_FIELD_ABSENT;
}

/* ---- Multi-channel request ---------------------------------------------- */

enum slot_key {
	KEY_CHANNEL,
	KEY_START,
	KEY_END,
	KEY_FREQ,
	KEY_RANGE,
	KEY_COUNT,
};

static const char *const slot_key_names[KEY_COUNT] = {
	[KEY_CHANNEL] = "CHANNEL",
	[KEY_START]   = "START",
	[KEY_END]     = "END",
	[KEY_FREQ]    = "FREQ",
	[KEY_RANGE]   = "RANGE",
};

#define ALL_KEYS_SEEN ((1u << KEY_COUNT) - 1)

struct field {
	const char *key;
	size_t key_len;
	const char *value;
	const char *value_end;
};

/*
 * Advance *pos to the next ';'-delimited segment [*seg, *seg_end).
 * Returns false once the string is exhausted, so a single trailing ';'
 * is tolerated while an empty segment in the middle (";;") is not.
 */
static bool next_segment(const char **pos, const char **seg, const char **seg_end)
{
	if (**pos == '\0') {
		return false;
	}

	const char *semi = strchr(*pos, ';');

	*seg = *pos;
	*seg_end = (semi != NULL) ? semi : *pos + strlen(*pos);
	*pos = (semi != NULL) ? semi + 1 : *seg_end;

	return true;
}

static bool split_field(const char *seg, const char *seg_end, struct field *f)
{
	const char *eq = memchr(seg, '=', (size_t)(seg_end - seg));

	if (eq == NULL || eq == seg) {
		return false;
	}

	f->key = seg;
	f->key_len = (size_t)(eq - seg);
	f->value = eq + 1;
	f->value_end = seg_end;

	return true;
}

static bool key_is(const struct field *f, const char *name)
{
	return f->key_len == strlen(name) && strncmp(f->key, name, f->key_len) == 0;
}

static int find_slot_key(const struct field *f)
{
	for (int k = 0; k < KEY_COUNT; k++) {
		if (key_is(f, slot_key_names[k])) {
			return k;
		}
	}

	return -1;
}

static enum request_error fail(struct request_error_info *err, enum request_error code,
			       int slot, const char *key)
{
	err->code = code;
	err->slot = slot;
	err->key = (key != NULL) ? key : "?";

	return code;
}

/* First missing key of a slot in table order, or NULL if complete. */
static const char *first_missing_key(uint8_t seen)
{
	for (int k = 0; k < KEY_COUNT; k++) {
		if ((seen & (1u << k)) == 0) {
			return slot_key_names[k];
		}
	}

	return NULL;
}

bool is_multi_request(const char *cmd)
{
	const char *pos = cmd;
	const char *seg;
	const char *seg_end;

	while (next_segment(&pos, &seg, &seg_end)) {
		struct field f;

		if (split_field(seg, seg_end, &f) && key_is(&f, "REQ")) {
			return true;
		}
	}

	return false;
}

enum request_error parse_multi_request(const char *cmd, struct multi_request *out,
				       struct request_error_info *err)
{
	int32_t values[MULTI_MAX_SLOTS][KEY_COUNT];
	uint8_t seen[MULTI_MAX_SLOTS] = {0};
	bool have_id = false;
	bool have_n = false;
	int32_t id = 0;
	int32_t n = 0;
	int slot = -1; /* -1 while still in the header */
	const char *pos = cmd;
	const char *seg;
	const char *seg_end;

	/* Level 1: syntax, structure, keys. */
	while (next_segment(&pos, &seg, &seg_end)) {
		struct field f;
		int32_t v;

		if (!split_field(seg, seg_end, &f)) {
			return fail(err, REQUEST_ERR_SYNTAX, slot, NULL);
		}

		if (key_is(&f, "SLOT")) {
			if (!have_id || !have_n) {
				return fail(err, REQUEST_ERR_SYNTAX, -1, NULL);
			}
			if (parse_int32_strict(f.value, f.value_end, &v) != 0 || v != slot + 1) {
				return fail(err, REQUEST_ERR_SYNTAX, -1, NULL);
			}
			if (v >= n) {
				return fail(err, REQUEST_ERR_SLOT_COUNT, -1, NULL);
			}
			if (slot >= 0 && seen[slot] != ALL_KEYS_SEEN) {
				return fail(err, REQUEST_ERR_MISSING, slot,
					    first_missing_key(seen[slot]));
			}

			slot = v;
			continue;
		}

		if (key_is(&f, "REQ")) {
			if (slot >= 0 || have_id ||
			    parse_int32_strict(f.value, f.value_end, &id) != 0 ||
			    id < REQ_ID_MIN || id > REQ_ID_MAX) {
				return fail(err, REQUEST_ERR_SYNTAX, -1, NULL);
			}

			have_id = true;
			continue;
		}

		if (key_is(&f, "N")) {
			if (slot >= 0 || have_n ||
			    parse_int32_strict(f.value, f.value_end, &n) != 0) {
				return fail(err, REQUEST_ERR_SYNTAX, -1, NULL);
			}
			if (n < 1 || n > MULTI_MAX_SLOTS) {
				return fail(err, REQUEST_ERR_SLOT_COUNT, -1, NULL);
			}

			have_n = true;
			continue;
		}

		if (slot < 0) {
			/* Only REQ and N may precede the first SLOT. */
			return fail(err, REQUEST_ERR_SYNTAX, -1, NULL);
		}

		int k = find_slot_key(&f);

		if (k < 0) {
			return fail(err, REQUEST_ERR_UNKNOWN, slot, NULL);
		}
		if (seen[slot] & (1u << k)) {
			return fail(err, REQUEST_ERR_DUP, slot, slot_key_names[k]);
		}
		if (parse_int32_strict(f.value, f.value_end, &values[slot][k]) != 0) {
			return fail(err, REQUEST_ERR_SYNTAX, slot, slot_key_names[k]);
		}

		seen[slot] |= (uint8_t)(1u << k);
	}

	if (!have_id || !have_n) {
		return fail(err, REQUEST_ERR_SYNTAX, -1, NULL);
	}
	if (slot >= 0 && seen[slot] != ALL_KEYS_SEEN) {
		return fail(err, REQUEST_ERR_MISSING, slot, first_missing_key(seen[slot]));
	}
	if (slot + 1 != n) {
		return fail(err, REQUEST_ERR_SLOT_COUNT, -1, NULL);
	}

	/* Level 2: hardware-independent ranges. */
	for (int s = 0; s < n; s++) {
		if (values[s][KEY_CHANNEL] < CHANNEL_MIN || values[s][KEY_CHANNEL] > CHANNEL_MAX) {
			return fail(err, REQUEST_ERR_RANGE, s, slot_key_names[KEY_CHANNEL]);
		}
		if (values[s][KEY_FREQ] <= 0) {
			return fail(err, REQUEST_ERR_RANGE, s, slot_key_names[KEY_FREQ]);
		}
		if (values[s][KEY_RANGE] <= 0) {
			return fail(err, REQUEST_ERR_RANGE, s, slot_key_names[KEY_RANGE]);
		}
	}

	out->id = (uint16_t)id;
	out->n = (uint8_t)n;

	for (int s = 0; s < n; s++) {
		out->slots[s] = (struct slot_cfg){
			.channel  = (uint8_t)values[s][KEY_CHANNEL],
			.start_mv = values[s][KEY_START],
			.end_mv   = values[s][KEY_END],
			.freq_hz  = values[s][KEY_FREQ],
			.range_ua = values[s][KEY_RANGE],
		};
	}

	return REQUEST_OK;
}

const char *request_error_str(enum request_error code)
{
	switch (code) {
	case REQUEST_OK:             return "OK";
	case REQUEST_ERR_SYNTAX:     return "SYNTAX";
	case REQUEST_ERR_SLOT_COUNT: return "SLOT_COUNT";
	case REQUEST_ERR_MISSING:    return "MISSING";
	case REQUEST_ERR_DUP:        return "DUP";
	case REQUEST_ERR_UNKNOWN:    return "UNKNOWN";
	case REQUEST_ERR_RANGE:      return "RANGE";
	case REQUEST_ERR_HW:         return "HW";
	}

	return "?";
}
```

## src/cmd_parser.h
```c
/*
 * Copyright (c) 2024 Croxel, Inc.
 *
 * SPDX-License-Identifier: Apache-2.0
 */

#ifndef CMD_PARSER_H_
#define CMD_PARSER_H_

#include <stdbool.h>
#include <stdint.h>

/*
 * Deliberately dependency-free (no Zephyr/BT headers) so this module can be
 * unit-tested as a plain host binary. Keep it that way.
 */

enum channel_parse_result {
	CHANNEL_FIELD_ABSENT,
	CHANNEL_FIELD_VALID,
	CHANNEL_FIELD_INVALID,
};

/**
 * @brief Find and validate a CHANNEL=<0..255> field in a ';'-delimited command.
 *
 * Scans ';'-delimited segments of @p cmd for one starting with "CHANNEL=".
 * The value must be a strict base-10 integer (optional leading '-', digits
 * only, no partial/trailing garbage) in the range 0..255. If more than one
 * CHANNEL= segment is present, only the first is considered.
 *
 * @param cmd NUL-terminated command string (may be empty).
 * @param out_channel Set to the parsed value on CHANNEL_FIELD_VALID; left
 *        untouched otherwise.
 * @return CHANNEL_FIELD_ABSENT if no CHANNEL= segment is found,
 *         CHANNEL_FIELD_VALID if found and valid,
 *         CHANNEL_FIELD_INVALID if found but malformed or out of range.
 */
enum channel_parse_result parse_channel_field(const char *cmd, uint8_t *out_channel);

/*
 * Multi-channel measurement request (UC8), see
 * docs/ble/BLE_CHUNKED_TRACE_PROTOCOL.md:
 *
 *   REQ=<id>;N=<n>;SLOT=0;CHANNEL=..;START=..;END=..;FREQ=..;RANGE=..;SLOT=1;...
 */

#define MULTI_MAX_SLOTS 6

struct slot_cfg {
	uint8_t channel;
	int32_t start_mv;
	int32_t end_mv;
	int32_t freq_hz;
	int32_t range_ua;
};

struct multi_request {
	uint16_t id;
	uint8_t n;
	struct slot_cfg slots[MULTI_MAX_SLOTS];
};

enum request_error {
	REQUEST_OK = 0,
	/* Level 1: syntax */
	REQUEST_ERR_SYNTAX,
	REQUEST_ERR_SLOT_COUNT,
	REQUEST_ERR_MISSING,
	REQUEST_ERR_DUP,
	REQUEST_ERR_UNKNOWN,
	/* Level 2: hardware-independent range */
	REQUEST_ERR_RANGE,
	/* Level 3: hardware capability. Never produced by the parser; reported
	 * by the firmware's hardware check.
	 */
	REQUEST_ERR_HW,
};

struct request_error_info {
	enum request_error code;
	/* -1 for request-level errors (reported as ERR=<code>), otherwise the
	 * slot the error belongs to (reported as V<slot>,<key>,<code>).
	 */
	int slot;
	/* Field name for slot-level errors; "?" when the field is not a known key. */
	const char *key;
};

/**
 * @brief Whether @p cmd is a multi-channel request (contains a REQ= field).
 *
 * Commands without REQ= are legacy single-channel commands.
 */
bool is_multi_request(const char *cmd);

/**
 * @brief Parse and validate (levels 1 and 2) a multi-channel request.
 *
 * All level-1 (syntax) errors take precedence over level-2 (range) errors.
 * Within a level, the first error in request order is reported.
 *
 * @param cmd NUL-terminated command string, without the '#' terminator.
 * @param out Filled on REQUEST_OK; unspecified otherwise.
 * @param err Filled on failure; untouched on REQUEST_OK.
 * @return REQUEST_OK or the error code (also stored in @p err).
 */
enum request_error parse_multi_request(const char *cmd, struct multi_request *out,
				       struct request_error_info *err);

/** @brief Wire token for an error code, e.g. "MISSING". */
const char *request_error_str(enum request_error code);

#endif /* CMD_PARSER_H_ */
```
